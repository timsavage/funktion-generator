;=======================================================================
; MCU Specs
;=======================================================================

.equ RAMEND, 0x08FF	; End of SRAM


;=======================================================================
; Registers
;=======================================================================

; System control and Reset

.equ MCUSR, 0x54
.equ WDRF, 3		; Watchdog System Reset Flag
.equ BORF, 2		; Brown-out Reset Flag
.equ EXTRF, 1		; External Reset Flag
.equ PORF, 0		; Power-on Reset Flag

.equ WDTCSR, 0x60	; Watchdog Timer Control Register
.equ WDIF, 7		; Watchdog Interrupt Flag
.equ WDIE, 6		; Watchdog Interrupt Enable
.equ WDP3, 5		; Watchdog Timer Prescaler bit 3
.equ WDCE, 4		; Watchdog Change Enable
.equ WDE, 3			; Watchdog System Reset Enable
.equ WDP2, 2		; Watchdog Timer Prescaler bit 2
.equ WDP1, 1		; ...
.equ WDP0, 0		; Watchdog Timer Prescaler bit 0


; I/O Ports

.equ MCUCR, 0x55	; MCU Control Register
.equ BODS, 6		; BOD Sleep
.equ BODSE, 5		; BOD Sleep Enable
.equ PUD, 4			; Pull-up Disable
.equ IVSEL, 1		; Interrupt Vector Select
.equ IVCE, 0		; Interrupt Vector Change Enable

.equ PINB, 0x23		; Port B Input Pins Address
.equ _PINB, (PINB-0x20)
.equ PINB7, 7		; Port B Input Pins Address bit 7
.equ PINB6, 6		; ...
.equ PINB5, 5		; ...
.equ PINB4, 4		; ...
.equ PINB3, 3		; ...
.equ PINB2, 2		; ...
.equ PINB1, 1		; ...
.equ PINB0, 0		; Port B Input Pins Address bit 0

.equ DDRB, 0x24		; Port B Data Direction Register
.equ _DDRB, (DDRB-0x20)
.equ DDRB7, 7		; Port B Data Direction bit 7
.equ DDRB6, 6		; ...
.equ DDRB5, 5		; ...
.equ DDRB4, 4		; ...
.equ DDRB3, 3		; ...
.equ DDRB2, 2		; ...
.equ DDRB1, 1		; ...
.equ DDRB0, 0		; Port B Data Direction bit 7

.equ PORTB, 0x25	; Port B Data Register
.equ _PORTB, (PORTB-0x20)
.equ PORTB7, 7		; Port B Data bit 7
.equ PORTB6, 6		; ...
.equ PORTB5, 5		; ...
.equ PORTB4, 4		; ...
.equ PORTB3, 3		; ...
.equ PORTB2, 2		; ...
.equ PORTB1, 1		; ...
.equ PORTB0, 0		; Port B Data bit 0

.equ PINC, 0x26		; Port C Input Pins Address
.equ _PINC, (PINC-0x20)
.equ PINC7, 7		; Port C Input Pins Address bit 7
.equ PINC6, 6		; ...
.equ PINC5, 5		; ...
.equ PINC4, 4		; ...
.equ PINC3, 3		; ...
.equ PINC2, 2		; ...
.equ PINC1, 1		; ...
.equ PINC0, 0		; Port C Input Pins Address bit 0

.equ DDRC, 0x27		; Port C Data Direction Register
.equ _DDRC, (DDRC-0x20)
.equ DDRC7, 7		; Port C Data Direction bit 7
.equ DDRC6, 6		; ...
.equ DDRC5, 5		; ...
.equ DDRC4, 4		; ...
.equ DDRC3, 3		; ...
.equ DDRC2, 2		; ...
.equ DDRC1, 1		; ...
.equ DDRC0, 0		; Port C Data Direction bit 7

.equ PORTC, 0x28	; Port C Data Register
.equ _PORTC, (PORTC-0x20)
.equ PORTC7, 7		; Port C Data bit 7
.equ PORTC6, 6		; ...
.equ PORTC5, 5		; ...
.equ PORTC4, 4		; ...
.equ PORTC3, 3		; ...
.equ PORTC2, 2		; ...
.equ PORTC1, 1		; ...
.equ PORTC0, 0		; Port C Data bit 0

.equ PIND, 0x29		; Port D Input Pins Address
.equ _PIND, (PIND-0x20)
.equ PIND7, 7		; Port D Input Pins Address bit 7
.equ PIND6, 6		; ...
.equ PIND5, 5		; ...
.equ PIND4, 4		; ...
.equ PIND3, 3		; ...
.equ PIND2, 2		; ...
.equ PIND1, 1		; ...
.equ PIND0, 0		; Port D Input Pins Address bit 0

.equ DDRD, 0x2A		; Port D Data Direction Register
.equ _DDRD, (DDRD-0x20)
.equ DDRD7, 7		; Port D Data Direction bit 7
.equ DDRD6, 6		; ...
.equ DDRD5, 5		; ...
.equ DDRD4, 4		; ...
.equ DDRD3, 3		; ...
.equ DDRD2, 2		; ...
.equ DDRD1, 1		; ...
.equ DDRD0, 0		; Port D Data Direction bit 0

.equ PORTD, 0x2B	; Port D Data Register
.equ _PORTD, (PORTD-0x20)
.equ PORTD7, 7		; Port D Data bit 7
.equ PORTD6, 6		; ...
.equ PORTD5, 5		; ...
.equ PORTD4, 4		; ...
.equ PORTD3, 3		; ...
.equ PORTD2, 2		; ...
.equ PORTD1, 1		; ...
.equ PORTD0, 0		; Port D Data bit 0


; TWI - 2-Wire Serial Interface

.equ TWBR, 0xB8		; TWI Bit Rate Register
.equ TWBR7, 7		; TWI Bit Rate Register bit 7
.equ TWBR6, 6		; ...
.equ TWBR5, 5		; ...
.equ TWBR4, 4		; ...
.equ TWBR3, 3		; ...
.equ TWBR2, 2		; ...
.equ TWBR1, 1		; ...
.equ TWBR0, 0		; TWI Bit Rate Register bit 0

.equ TWSR, 0xB9		; TWI Status Register
.equ TWS4, 7		; TWI Status bit 4
.equ TWS3, 6		; ...
.equ TWS2, 5		; ...
.equ TWS1, 4		; ...
.equ TWS0, 3		; TWI Status bit 0
.equ TWPS1, 1		; TWI Pre-scaler bit 1
.equ TWPS0, 0		; TWI Pre-scaler bit 0

.equ TWAR, 0xBA		; TWI (Slave) Address Register
.equ TWA6, 7		; TWI Address bit 6
.equ TWA5, 6		; ...
.equ TWA4, 5		; ...
.equ TWA3, 4		; ...
.equ TWA2, 3		; ...
.equ TWA1, 2		; ...
.equ TWA0, 1		; TWI Address bit 0
.equ TWGCE, 0		; TWI General Call Recognition Enable Bit

.equ TWDR, 0xBB		; TWI Data Register
.equ TWD7, 7		; TWI Data bit 7
.equ TWD6, 6		; ...
.equ TWD5, 5		; ...
.equ TWD4, 4		; ...
.equ TWD3, 3		; ...
.equ TWD2, 2		; ...
.equ TWD1, 1		; ...
.equ TWD0, 0		; TWI Data bit 0

.equ TWCR, 0xBC		; TWI Control Register
.equ TWINT, 7		; TWI Interupt flag
.equ TWEA, 6		; TWI Enable Acknowledge
.equ TWSTA, 5		; TWI START Condition
.equ TWSTO, 4		; TWI STOP Condition
.equ TWWC, 3		; TWI Write Collision Flag
.equ TWEN, 2		; TWI Enable
.equ TWIE, 0		; TWI Interrupt Enable

.equ TWAMR, 0xBD	; TWI (Slave) Address Mask Register
.equ TWAM6, 7		; TWI (Slave) Address bit 6
.equ TWAM5, 6		; ...
.equ TWAM4, 5		; ...
.equ TWAM3, 4		; ...
.equ TWAM2, 3		; ...
.equ TWAM1, 2		; ...
.equ TWAM0, 1		; TWI (Slave) Address bit 0


;=======================================================================
; Interrupt Vectors
;=======================================================================
.equ RESET_addr, 0x0000			; External Pin, Power-on Reset, Brown-out Reset and Watchdog System Reset
.equ INT0_addr, 0x0002			; External Interrupt Request 0
.equ INT1_addr, 0x0004			; External Interrupt Request 0
.equ PCINT0_addr, 0x0006		; Pin Change Interrupt Request 0
.equ PCINT1_addr, 0x0008		; Pin Change Interrupt Request 1
.equ PCINT2_addr, 0x000A		; Pin Change Interrupt Request 2
.equ WDT_addr, 0x000C			; Watchdog Time-out Interrupt
.equ TIMER2_COMPA_addr, 0x000E	; Timer/Counter2 Compare Match A
.equ TIMER2_COMPB_addr, 0x0010	; Timer/Coutner2 Compare Match B
.equ TIMER2_OVF_addr, 0x0012	; Timer/Counter2 Overflow
.equ TIMER1_CAPT_addr, 0x0014	; Timer/Counter1 Capture Event
.equ TIMER1_COMPA_addr, 0x0016	; Timer/Counter1 Compare Match A
.equ TIMER1_COMPB_addr, 0x0018	; Timer/Coutner1 Compare Match B
.equ TIMER1_OVF_addr, 0x001A	; Timer/Counter1 Overflow
.equ TIMER0_COMPA_addr, 0x001C  ; Timer/Counter0 Compare Match A
.equ TIMER0_COMPB_addr, 0x001E	; Timer/Coutner0 Compare Match B
.equ TIMER0_OVF_addr, 0x0020	; Timer/Counter0 Overflow
.equ SPI_STC_addr, 0x0022		; SPI Serial Transfer Complete
.equ USART_RX_addr, 0x0024		; USART Rx Complete
.equ USART_UDRE_addr, 0x0026	; USART Data Register Empty
.equ USART_TX_addr, 0x0028		; USART Tx Complete
.equ ADC_addr, 0x002A			; ADC Conversion Complete
.equ EE_READY_addr, 0x002C		; EEPROM Ready
.equ ANALOG_COMP_addr, 0x002E	; Analog Comparator
.equ TWI_addr, 0x0030			; 2-wire Serial Interface (I2C)
.equ SPM_READY_addr, 0x0032		; Store Program Memory Ready
